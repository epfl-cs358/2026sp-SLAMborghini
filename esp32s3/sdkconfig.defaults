## profiler/examples/esp32s3_build/sdkconfig.defaults
```kconfig
# Profiler build — ESP32-S3
# (mirrors profiler/sdkconfig.defaults)

CONFIG_ESPTOOLPY_FLASHSIZE_2MB=y
CONFIG_ESPTOOLPY_FLASHSIZE="2MB"

CONFIG_FREERTOS_GENERATE_RUN_TIME_STATS=y
CONFIG_FREERTOS_USE_TRACE_FACILITY=y
CONFIG_FREERTOS_USE_STATS_FORMATTING_FUNCTIONS=y
CONFIG_FREERTOS_VTASKLIST_INCLUDE_COREID=y
CONFIG_FREERTOS_CHECK_STACKOVERFLOW=y
CONFIG_FREERTOS_WATCHPOINT_END_OF_STACK=y
CONFIG_HEAP_TRACING=y
CONFIG_HEAP_TRACING_STANDALONE=y
CONFIG_PERFMON=y
CONFIG_HTTPD_WS_SUPPORT=y
```
